#include <behaviors.dtsi>
#include <dt-bindings/zmk/keys.h>
//#include <dt-bindings/zmk/bt.h>

/ {
    keymap {
        default_layer {
            compatible = "zmk,keymap";
            bindings = <
               &kp Y    &kp U   &kp I    &kp O    &kp P   &kp KP_n4    
               &kp H    &kp J   &kp K    &kp L    &kp EXCL   &kp KP_N5  
               &kp N    &kp M   &kp AT    &kp POUND    &kp DLLR   &kp KP_N6
               &kp PRCNT    &kp CARET   &kp AMPS  
            >;   
        };
    };
};